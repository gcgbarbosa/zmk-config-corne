## config/west.yml
```yaml
manifest:
  remotes:
    - name: zmkfirmware
      url-base: https://github.com/zmkfirmware
    - name: gcgbarbosa
      url-base: https://github.com/gcgbarbosa
  projects:
    - name: zmk
      remote: gcgbarbosa
      revision: mouse-ftc
      import: app/west.yml
  self:
    path: config
```
